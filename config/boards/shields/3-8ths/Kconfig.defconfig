## config/boards/shields/3-8ths/Kconfig.defconfig
```kconfig
# Copyright (c) 2020 The ZMK Contributors
# SPDX-License-Identifier: MIT

if SHIELD_3-8ths

config ZMK_KEYBOARD_NAME
	default "3-8ths"

endif
```

## config/boards/shields/3_8ths/Kconfig.defconfig
```kconfig
# Copyright (c) 2020 The ZMK Contributors
# SPDX-License-Identifier: MIT

if SHIELD_3_8ths

config ZMK_KEYBOARD_NAME
	default "3_8ths"

endif
```

## config/boards/shields/3_8ths/Kconfig.shield
```kconfig
# Copyright (c) 2020 The ZMK Contributors
# SPDX-License-Identifier: MIT

config SHIELD_3_8ths
	def_bool $(shields_list_contains,3_8ths)
```
